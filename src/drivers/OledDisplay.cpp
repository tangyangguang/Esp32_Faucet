#include "drivers/OledDisplay.h"

#include <Arduino.h>
#include <Wire.h>
#include <algorithm>
#include <cstring>

namespace faucet {
namespace {

constexpr std::uint8_t kWidth = 128;
constexpr std::uint8_t kPages = 4;
constexpr std::uint8_t kControlCommand = 0x00;
constexpr std::uint8_t kControlData = 0x40;

constexpr std::uint8_t kFont5x7[][5] = {
    {0x00, 0x00, 0x00, 0x00, 0x00},  // space
    {0x00, 0x00, 0x5F, 0x00, 0x00},  // !
    {0x00, 0x07, 0x00, 0x07, 0x00},  // "
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    {0x61, 0x51, 0x49, 0x45, 0x43},  // Z
};

const std::uint8_t* glyph(char c) {
    if (c >= 'a' && c <= 'z') {
        c = static_cast<char>(c - 'a' + 'A');
    }
    if (c < ' ' || c > 'Z') {
        c = '?';
    }
    return kFont5x7[c - ' '];
}

}  // namespace

OledDisplay::OledDisplay(std::uint8_t sdaPin, std::uint8_t sclPin, std::uint8_t address)
    : sdaPin_(sdaPin),
      sclPin_(sclPin),
      address_(address),
      present_(false),
      on_(false),
      lastFrame_{DisplayPage::Sleep, false, {}, {}} {}

bool OledDisplay::begin() {
    Wire.begin(sdaPin_, sclPin_);
    Wire.beginTransmission(address_);
    present_ = Wire.endTransmission() == 0;
    if (!present_) {
        return false;
    }

    const std::uint8_t init[] = {
        0xAE, 0xD5, 0x80, 0xA8, 0x1F, 0xD3, 0x00, 0x40, 0x8D, 0x14, 0x20, 0x00,
        0xA1, 0xC8, 0xDA, 0x02, 0x81, 0x8F, 0xD9, 0xF1, 0xDB, 0x40, 0xA4, 0xA6,
    };
    for (const std::uint8_t value : init) {
        if (!command(value)) {
            present_ = false;
            return false;
        }
    }
    clear();
    setOn(true);
    return true;
}

bool OledDisplay::present() const {
    return present_;
}

void OledDisplay::apply(const DisplayFrame& frame) {
    if (!present_) {
        return;
    }
    if (frame.on != on_) {
        setOn(frame.on);
    }
    if (!frame.on) {
        lastFrame_ = frame;
        return;
    }
    if (std::memcmp(&frame, &lastFrame_, sizeof(frame)) == 0) {
        return;
    }
    clear();
    drawLine(0, frame.line1);
    drawLine(2, frame.line2);
    lastFrame_ = frame;
}

bool OledDisplay::command(std::uint8_t value) {
    Wire.beginTransmission(address_);
    Wire.write(kControlCommand);
    Wire.write(value);
    return Wire.endTransmission() == 0;
}

bool OledDisplay::data(const std::uint8_t* values, std::size_t len) {
    std::size_t offset = 0;
    while (offset < len) {
        const std::size_t chunk = std::min<std::size_t>(16, len - offset);
        Wire.beginTransmission(address_);
        Wire.write(kControlData);
        for (std::size_t i = 0; i < chunk; ++i) {
            Wire.write(values[offset + i]);
        }
        if (Wire.endTransmission() != 0) {
            return false;
        }
        offset += chunk;
    }
    return true;
}

void OledDisplay::clear() {
    std::uint8_t zeros[kWidth]{};
    for (std::uint8_t page = 0; page < kPages; ++page) {
        command(static_cast<std::uint8_t>(0xB0 | page));
        command(0x00);
        command(0x10);
        data(zeros, sizeof(zeros));
    }
}

void OledDisplay::setOn(bool on) {
    command(on ? 0xAF : 0xAE);
    on_ = on;
}

void OledDisplay::drawLine(std::uint8_t page, const char* text) {
    command(static_cast<std::uint8_t>(0xB0 | page));
    command(0x00);
    command(0x10);

    std::uint8_t buffer[kWidth]{};
    std::size_t x = 0;
    for (const char* p = text ? text : ""; *p && x + 6 <= sizeof(buffer); ++p) {
        const std::uint8_t* g = glyph(*p);
        for (std::uint8_t i = 0; i < 5; ++i) {
            buffer[x++] = g[i];
        }
        buffer[x++] = 0x00;
    }
    data(buffer, sizeof(buffer));
}

}  // namespace faucet
